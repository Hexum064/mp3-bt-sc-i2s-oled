## sdkconfig.defaults
```kconfig
CONFIG_LOG_MAXIMUM_LEVEL=5

CONFIG_EXAMPLE_FORMAT_IF_MOUNT_FAILED=n
CONFIG_FATFS_LONG_FILENAMES=y
CONFIG_FATFS_LFN_HEAP=y

#
# SSD1306 Configuration
#
# CONFIG_I2C_INTERFACE=y
CONFIG_SPI_INTERFACE=y
CONFIG_SSD1306_128x32=y
# CONFIG_SSD1306_128x64=y
CONFIG_OFFSETX=0
# CONFIG_FLIP is not set
# CONFIG_SCL_GPIO=22
# CONFIG_SDA_GPIO=21
# CONFIG_RESET_GPIO=-1
# end of SSD1306 Configuration
CONFIG_MOSI_GPIO=21
CONFIG_SCLK_GPIO=19
CONFIG_CS_GPIO=25
CONFIG_DC_GPIO=23
CONFIG_RESET_GPIO=22

# Override some defaults so BT stack is enabled and
# Classic BT is enabled
CONFIG_ESP32_WIFI_ENABLED=n
CONFIG_BT_ENABLED=y
CONFIG_BTDM_CTRL_MODE_BLE_ONLY=n
CONFIG_BTDM_CTRL_MODE_BR_EDR_ONLY=y
CONFIG_BTDM_CTRL_MODE_BTDM=n
CONFIG_BT_BLUEDROID_ENABLED=y
CONFIG_BT_CLASSIC_ENABLED=y
CONFIG_BT_A2DP_ENABLE=y
CONFIG_BT_SPP_ENABLED=n
CONFIG_BT_BLE_ENABLED=n




# Remove later
# Partition Table
#
#CONFIG_PARTITION_TABLE_CUSTOM=y
#CONFIG_PARTITION_TABLE_CUSTOM_FILENAME="partitions.csv"
#CONFIG_PARTITION_TABLE_FILENAME="partitions.csv"
#CONFIG_PARTITION_TABLE_CUSTOM_APP_BIN_OFFSET=0x1F000
#CONFIG_APP_OFFSET=0x1F000

CONFIG_ESPTOOLPY_FLASHSIZE_4MB=y
CONFIG_ESP32_DEFAULT_CPU_FREQ_240=y
CONFIG_ESP32_DEFAULT_CPU_FREQ_MHZ=240
```
